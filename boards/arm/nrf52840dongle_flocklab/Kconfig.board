## boards/arm/nrf52840dongle_flocklab/Kconfig.board
```kconfig
# nRF52840 Dongle FLOCKLAB board configuration

# Copyright (c) 2018 Nordic Semiconductor ASA
# SPDX-License-Identifier: Apache-2.0

config BOARD_NRF52840DONGLE_FLOCKLAB
	bool "nRF52840 DONGLE FLOCKLAB"
	depends on SOC_NRF52840_QIAA
```
